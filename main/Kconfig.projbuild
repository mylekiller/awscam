## main/Kconfig.projbuild
```kconfig
menu "AWSCAM Project Configuration"

config WIFI_SSID
    string "WiFi SSID"
    default "ND-guest"
    help
        SSID (network name) for the demo to connect to.

config WIFI_PASSWORD
    string "WiFi Password"
    default ""
    help
        Password for your network.
        
config XCLK_FREQ
    int "XCLK Frequency"
    default "20000000"
    help
        The XCLK Frequency in Herz.

config AWS_EXAMPLE_CLIENT_ID
    string "AWS IoT Client ID"
    default "000"
    help
        AWS IoT Client ID for the example. Should be unique for every device.

choice EXAMPLE_CERT_SOURCE
    prompt "AWS IoT Certificate Source"
    default EXAMPLE_EMBEDDED_CERTS
    help
       AWS IoT requires loading of a device-specific certificate and private key,
       and a common Root CA Certificate. These can be compiled into the example
       app, or they can be loaded via the filesystem from an SD card.

config EXAMPLE_EMBEDDED_CERTS
    bool "Embed into app"
config EXAMPLE_SDCARD_CERTS
    bool "Load from SD card"
    select EXAMPLE_FILESYSTEM_CERTS
endchoice

# Currently this is equivalent to EXAMPLE_SDCARD_CERTS,
# however eventually we want to support more filesystem
# sources (SPIFFS, etc.) So this hidden config item
# is selected whenever the item should load from filesystem.
config EXAMPLE_FILESYSTEM_CERTS
    bool

config EXAMPLE_CERTIFICATE_PATH
    string "Device Certificate Path"
    depends on EXAMPLE_FILESYSTEM_CERTS
    default "/sdcard/certificate.pem.crt"

config EXAMPLE_PRIVATE_KEY_PATH
    string "Device Private Key Path"
    depends on EXAMPLE_FILESYSTEM_CERTS
    default "/sdcard/private.pem.key"

config EXAMPLE_ROOT_CA_PATH
    string "Root CA Certificate Path"
    depends on EXAMPLE_FILESYSTEM_CERTS
    default "/sdcard/aws-root-ca.pem"

        
menu "Pin Configuration"
    config D0
        int "D0"
        default "4"
    config D1
        int "D1"
        default "5"
    config D2
        int "D2"
        default "18"
    config D3
        int "D3"
        default "19"
    config D4
        int "D4"
        default "36"
    config D5
        int "D5"
        default "39"
    config D6
        int "D6"
        default "34"
    config D7
        int "D7"
        default "35"
    config XCLK
        int "XCLK"
        default "21"
    config PCLK
        int "PCLK"
        default "22"
    config VSYNC
        int "VSYNC"
        default "25"
    config HREF
        int "HREF"
        default "23"
    config SDA
        int "SDA"
        default "26"
    config SCL
        int "SCL"
        default "27"
    config RESET
        int "RESET"
        default "2"
endmenu

endmenu
```

## sdkconfig.defaults
```kconfig
CONFIG_ENABLE_TEST_PATTERN=n
CONFIG_OV2640_SUPPORT=y
CONFIG_OV7725_SUPPORT=y
CONFIG_ESP32_DEFAULT_CPU_FREQ_240=y
CONFIG_ESP32_DEFAULT_CPU_FREQ_MHZ=240
CONFIG_MEMMAP_SMP=y
CONFIG_TASK_WDT=n
CONFIG_FREERTOS_UNICORE=n
CONFIG_FREERTOS_HZ=100
CONFIG_LOG_DEFAULT_LEVEL_INFO=y
CONFIG_LOG_DEFAULT_LEVEL=3

# Enable AWS IoT SDK support
CONFIG_AWS_IOT_SDK=y

# Enable FATFS read only with long filename support
# for loading Cert/CA/etc from filesystem
# (if enabled in config)
CONFIG_FATFS_READONLY=y
CONFIG_FATFS_CODEPAGE_437=y
CONFIG_FATFS_LFN_HEAP=y

# Enable TLS asymmetric in/out content length
CONFIG_MBEDTLS_ASYMMETRIC_CONTENT_LEN=y
```
